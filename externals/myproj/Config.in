## externals/myproj/Config.in
```kconfig
source "$BR2_EXTERNAL_MYPROJ_PATH/package/hello-acu6/Config.in"
source "$BR2_EXTERNAL_MYPROJ_PATH/package/supl-3gpp-lpp-client/Config.in"
source "$BR2_EXTERNAL_MYPROJ_PATH/package/runscript/Config.in"
source "$BR2_EXTERNAL_MYPROJ_PATH/package/my-modem/Config.in"
source "$BR2_EXTERNAL_MYPROJ_PATH/package/serial-test/Config.in"
source "$BR2_EXTERNAL_MYPROJ_PATH/package/test-file/Config.in"
```

## externals/myproj/package/my-modem/Config.in
```kconfig
config BR2_PACKAGE_MY_MODEM
	bool "my-modem"
	select BR2_PACKAGE_ACTIA_LIB
	help
	   Modified modemcontrol
```

## externals/myproj/package/serial-test/Config.in
```kconfig
config BR2_PACKAGE_SERIAL_TEST
	bool "actia-serial-demo"
	select BR2_PACKAGE_ACTIA_LIB
	help
	   Actia serial-demo
```

## externals/myproj/package/supl-3gpp-lpp-client/Config.in
```kconfig
config BR2_PACKAGE_SUPL_3GPP_LPP_CLIENT
	bool "supl-3gpp-lpp-client"
	depends on BR2_TOOLCHAIN_HAS_THREADS
	depends on BR2_USE_WCHAR 
	depends on BR2_TOOLCHAIN_HAS_SSP 
	depends on BR2_INSTALL_LIBSTDCPP
	select BR2_PACKAGE_OPENSSL
	select BR2_PACKAGE_HOST_CMAKE
	select BR2_PACKAGE_HOST_NINJA
	select BR2_PACKAGE_CMAKE
	select BR2_PACKAGE_NINJA
	select BR2_PACKAGE_ACTIA_LIB
	select BR2_PACKAGE_MY_MODEM
	help
	  Example SUPL 3GPP LPP client for connecting and requesting
	  assistance information. Including support for converting
	  3GPP LPP assistance data to RTCM.

	  https://github.com/Ericsson/SUPL-3GPP-LPP-client

comment "supl-3gpp-lpp-client needs a toolchain w/ threads, wchar, SSP, C++"
	depends on !BR2_TOOLCHAIN_HAS_THREADS || !BR2_USE_WCHAR || !BR2_TOOLCHAIN_HAS_SSP || !BR2_INSTALL_LIBSTDCPP
```
